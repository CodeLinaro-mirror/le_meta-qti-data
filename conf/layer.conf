## conf/layer.conf
```bitbake
BBFILES += "${LAYERDIR}/recipes/*/*.bb \
            ${LAYERDIR}/recipes/*/*.bbappend \
            ${LAYERDIR}/recipes-*/*/*.bb \
            ${LAYERDIR}/recipes-*/*/*.bbappend \
            ${LAYERDIR}/recipes-products/images/*.bbappend \
            ${LAYERDIR}/recipes-support/*/*.bbappend"

BBFILES += "${@bb.utils.contains('BASEMACHINE', 'echo', \
           '${LAYERDIR}/rdkb/recipes-*/*/*.bb ${LAYERDIR}/rdkb/recipes-*/*/*.bbappend', \
           '', d)}"
BBMASK:append:echo = " ^.*/linux-qcom-custom_.*\.bbappend$"
BBMASK:append:sa535m = " ^.*/linux-msm-src_.*\.bbappend$"

BBPATH .= ":${LAYERDIR}"
BBFILE_COLLECTIONS += "qti-data"
BBFILE_PRIORITY_qti-data = "12"
BBFILE_PATTERN_qti-data := "^${LAYERDIR}/"
UNPACKDIR ??= "${WORKDIR}"

LAYERSERIES_COMPAT_qti-data = "dunfell kirkstone scarthgap wrynose"
require conf/machine/include/rdkb-distro-data.inc
```

## conf/machine/include/rdkb-distro-data.inc
```bitbake
PREFERRED_VERSION_dnsmasq:echo = "2.83"
PREFERRED_VERSION_mosquitto:kirkstone:forcevariable = "2.0.18"

PREFERRED_PROVIDER_glib-openssl = "glib-networking"
```

## owrt-packages/newstrongswan/Config.in
```kconfig
if PACKAGE_newstrongswan
comment "Configuration"

# --with-routing-table
config NEWSTRONGSWAN_ROUTING_TABLE
	string
	prompt "Set the IPsec routing table ID"
	default "220"

#  --with-routing-table-prio
config NEWSTRONGSWAN_ROUTING_TABLE_PRIO
	string
	prompt "Set the IPsec routing table priority"
	default "220"

comment "Packages"

endif
```
